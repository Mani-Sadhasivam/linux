## Documentation/devicetree/bindings/reset/actions,owl-reset.txt
```
Actions Semi Owl SoCs Reset Management Unit (RMU)
=================================================

Please also refer to reset.txt in this directory for common reset
controller binding usage.

The RMU registers are part of the system-controller block on Owl SoCs.

Required properties:
- compatible: Should be "actions,s900-rmu"
- #reset-cells: Should be 1

All available resets are defined as preprocessor macros in corresponding
dt-bindings/reset/actions,s900-rmu.h header and can be used in device
tree sources.

Parent node should have the following properties :
- compatible: "syscon", "simple-mfd"
- reg: physical base address of the system controller and length of
  memory mapped region.

Example:

        sysctrl: system-controller@e0160000 {
                compatible = "syscon", "simple-mfd";
                reg = <0x0 0xe0160000 0x0 0x1000>;

                rmu: reset-controller {
                        compatible = "actions,s900-rmu";
                        #reset-cells = <1>;
                };
        };
```

## drivers/pci/pwrctrl/Kconfig
```kconfig
# SPDX-License-Identifier: GPL-2.0-only

config HAVE_PWRCTRL
	bool

config PCI_PWRCTRL
	tristate

config PCI_PWRCTRL_PWRSEQ
	tristate
	select POWER_SEQUENCING
	select PCI_PWRCTRL

config PCI_PWRCTRL_SLOT
	tristate "PCI Power Control driver for PCI slots"
	select PCI_PWRCTRL
	help
	  Say Y here to enable the PCI Power Control driver to control the power
	  state of PCI slots.

	  This is a generic driver that controls the power state of different
	  PCI slots. The voltage regulators powering the rails of the PCI slots
	  are expected to be defined in the devicetree node of the PCI bridge.

# deprecated
config HAVE_PWRCTL
	bool
	select HAVE_PWRCTRL

# deprecated
config PCI_PWRCTL_PWRSEQ
	tristate
	select PCI_PWRCTRL_PWRSEQ

config PCI_PWRCTRL_TC9563
	tristate "PCI Power Control driver for TC9563 PCIe switch"
	select PCI_PWRCTRL
	help
	  Say Y here to enable the PCI Power Control driver of TC9563 PCIe
	  switch.

	  This driver enables power and configures the TC9563 PCIe switch
	  through i2c.
```
