## Documentation/devicetree/bindings/connector/pci-m2-connector.yaml
```yaml
# SPDX-License-Identifier: GPL-2.0-only
%YAML 1.2
---
$id: http://devicetree.org/schemas/connector/m2-connector.yaml#
$schema: http://devicetree.org/meta-schemas/core.yaml#

title: PCIe M.2 Connector

maintainers:
  - Manivannan Sadhasivam <manivannan.sadhasivam@oss.qualcomm.com>

description:
  A PCIe M.2 connector node represents a physical PCIe M.2 connector.

properties:
  compatible:
    const: pci-m2-M-connector

  vpcie3v3-supply:
    description: A phandle to the regulator for 3.3v supply.

  vio1v8-supply:
    description: A phandle to the regulator for VIO 1.8v supply.

  ports:
    $ref: /schemas/graph.yaml#/properties/ports
    description: OF graph bindings modeling the interfaces exposed on the
      connector. Since a single connector can have multiple interfaces, every
      interface has an assigned OF graph port number as described below.

    properties:
      port@0:
        $ref: /schemas/graph.yaml#/properties/port
        description: PCIe interface

      port@1:
        $ref: /schemas/graph.yaml#/properties/port
        description: UART interface

    required: # Check
      - port@0

required:
  - compatible
  - vpcie3v3-supply

unevaluatedProperties: false

examples:
  - |
    #include <dt-bindings/gpio/gpio.h>

    m2-connector {
      compatible = "m2-connector";
      key = "a";
      vpcie3v3-supply = <&vreg_wcn_3p3>;
      vpcie1v8-supply = <&vreg_l15b_1p8>;
      w-disable1-gpios = <&tlmm 117 GPIO_ACTIVE_LOW>;
      w-disable2-gpios = <&tlmm 116 GPIO_ACTIVE_LOW>;

      ports {
        #address-cells = <1>;
        #size-cells = <0>;

        port@0 {
          reg = <0>;
          m2_pcie_ep: endpoint {
            remote-endpoint = <&pcie4_port0_ep>;
          };
        };

        port@1 {
          reg = <1>;
          m2_uart_ep: endpoint {
            remote-endpoint = <&uart14_ep>;
          };
        };
      };
    };
```

## Documentation/devicetree/bindings/pci/pci-ep-generic.yaml
```yaml
# SPDX-License-Identifier: (GPL-2.0-only OR BSD-2-Clause)
%YAML 1.2
---
$id: http://devicetree.org/schemas/pci/pci-ep-generic.yaml#
$schema: http://devicetree.org/meta-schemas/core.yaml#

title: Generic PCI Endpoint Controller

maintainers:
  - Manivannan Sadhasivam <mani@kernel.org>

description:
  A PCI Endpoint Controller that is initialised by firmware or provided by an
  emulation, and is configured through a memory-mapped control region.

properties:
  compatible:
    const: pci-ep-generic

  reg:
    items:
      - description: control region
      - description: outbound window

  reg-names:
    items:
      - const: ctrl
      - const: outbound

required:
  - compatible
  - reg
  - reg-names

allOf:
  - $ref: pci-ep.yaml#

unevaluatedProperties: false

examples:
  - |
    pcie-ep@10000000 {
        compatible = "pci-ep-generic";
        reg = <0x10000000 0x1000>,
              <0x20000000 0x8000000>;
        reg-names = "ctrl", "outbound";
    };
...
```

## drivers/pci/connector/Kconfig
```kconfig
# SPDX-License-Identifier: GPL-2.0

menu "PCI connector drivers"
	depends on PCI

config PCI_CONNECTOR_M2
	tristate "PCIe M.2 Connector driver"
	help
	 Enables support for handling the PCIe M.2 connector

endmenu
```
